## drivers/misc/mediatek/alsps/stk3x1x_driver/Kconfig
```kconfig
config MTK_STK3X1X_DRIVER
	bool "MTK_STK3X1X_DRIVER for MediaTek package"
	default n
	help
	It support different type sensor
	in this platform. If this option
	is set, it will support ambient
	and light sensor MTK_STK3X1X_DRIVER.
```

## drivers/misc/mediatek/magnetometer/mmc3416x/Kconfig
```kconfig
config MTK_MMC3416X
	bool "MTK_MMC3416X for MediaTek package"
	default n
	help
	  It support different magnetometer sensor.
          If this option is set,
	  it will support
          MTK_MMC3416X magnetometer.
```
